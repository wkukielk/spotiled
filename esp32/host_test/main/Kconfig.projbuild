## esp32/host_test/main/Kconfig.projbuild
```kconfig
menu "Test configuration"

    config GTEST_FILTER
        string "Test filter regex"
        default "$(GTEST_FILTER)" if "$(GTEST_FILTER)" != ""

endmenu
```

## esp32/main/Kconfig.projbuild
```kconfig
menu "Project configuration"

    choice BUILD_TYPE
        prompt "Build type"
        default DEV

        config DEV
            bool "Development build"

        config RELEASE
            bool "Release build"
            select SECURE_FLASH_ENC_ENABLED
            select NVS_ENCRYPTION

        config CI
            bool "CI build"
    endchoice

endmenu
```
